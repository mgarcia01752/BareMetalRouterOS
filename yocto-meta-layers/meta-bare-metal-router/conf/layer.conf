## yocto-meta-layers/meta-bare-metal-router/conf/layer.conf
```bitbake
BBPATH .= ":${LAYERDIR}"

BBFILES += "${LAYERDIR}/recipes-*/*/*.bb \
            ${LAYERDIR}/recipes-*/*/*.bbappend"

BBFILE_COLLECTIONS += "meta-bare-metal-router"
BBFILE_PATTERN_meta-bare-metal-router = "^${LAYERDIR}/"
BBFILE_PRIORITY_meta-bare-metal-router = "6"

LAYERDEPENDS_meta-bare-metal-router = "core"
LAYERSERIES_COMPAT_meta-bare-metal-router = "scarthgap"
```
